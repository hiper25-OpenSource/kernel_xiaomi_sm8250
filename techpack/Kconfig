## techpack/Kconfig
```kconfig
menu "Tech packages"

source "techpack/data/Kconfig"

menu "Camera packages"

config TECHPACK_CAMERA_XIAOMI
    bool "Xiaomi camera"
    help
      Xiaomi camera

config TECHPACK_CAMERA_XIAOMI_CAS
    bool "Xiaomi camera CAS"
    help
      Xiaomi camera CAS

config TECHPACK_CAMERA_XIAOMI_TABLET
    bool "Xiaomi camera tablet"
    help
      Xiaomi camera tablet

config CAMERA_NONEDXO
	bool "Enable None-DXO Camera modifications"
	help
	  "Enable None-DXO Camera modifications"

config CAMERA_CAS
	bool "Enable Xiaomi CAS Camera modifications"
	help
	  "Enable Xiaomi CAS Camera modifications"

endmenu

endmenu
```
